## config/west.yml
```yaml
manifest:
  remotes:
    - name: opalinesque
      url-base: https://github.com/opalinesque
  projects:
    - name: zmk
      remote: opalinesque
      revision: main
      import: app/west.yml
  self:
    path: config
```
